## Config.in
```kconfig
config ELOG_ASSERT
	bool "Assertion"
	default n
	help
	  Build elog library with internal assertions.

config ELOG_DEBUG
	bool "Enable internal debugging"
	default n
	help
	  Build elog library with internal debugging support.

config ELOG_HAVE_IMPL
	bool
	default n

config ELOG_HAVE_FORMAT
	bool
	default n

config ELOG_HAVE_FACILITY
	bool
	default n

config ELOG_STDIO
	bool "Standard I/Os"
	select ELOG_HAVE_IMPL
	select ELOG_HAVE_FORMAT
	default y
	help
	  Build elog library with standard I/O error support.

config ELOG_SYSLOG
	bool "Syslog"
	select ELOG_HAVE_IMPL
	select ELOG_HAVE_FORMAT
	select ELOG_HAVE_FACILITY
	default y
	help
	  Build elog library with syslog support.

config ELOG_MQUEUE
	bool "Message queue"
	select ELOG_HAVE_IMPL
	select ELOG_HAVE_FACILITY
	default y
	help
	  Build elog library with POSIX message queue support.

config ELOG_MQUEUE_PARSER
	bool "Message queue parser"
	default n
	help
	  Build elog library with POSIX message queue parsing support.

config ELOG_MQUEUE_UTIL
	bool "Message queue utility"
	depends on ELOG_MQUEUE
	select ELOG_MQUEUE_PARSER
	default ELOG_MQUEUE
	help
	  Build `elog_mqueue', a utility to manipulate an eLog message queue.

config ELOG_MULTI
	bool "Multi logger"
	depends on ELOG_HAVE_IMPL
	default ELOG_HAVE_IMPL
	help
	  Build elog library with multiple logger support.

config ELOG_LOGGER
	bool "elogger utility"
	depends on ELOG_HAVE_IMPL
	select ELOG_MULTI
	default ELOG_HAVE_IMPL
	help
	  Build elog library with multiple logger support.

config ELOG_SAMPLE
	bool "elogger sample apps"
	depends on ELOG_HAVE_IMPL
	default n
	help
	  Build elog library with sample code applications.

# ex: filetype=kconfig
```
